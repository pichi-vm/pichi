/dts-v1/;

/*
 * Trusted kaslr-seed overlay (aarch64).
 *
 * tatu merges this onto the measured base DTB *before* the host overlay, so the
 * kernel reads a fresh, guest-generated `/chosen/kaslr-seed` that never lived in
 * the measured image. The 8-byte seed below is a zero placeholder: tatu
 * overwrites it at boot with guest entropy (RNDR) — see `kaslr.rs` /
 * `arch_aarch64::prepare_merge_base`.
 *
 * Regenerate the committed binary after editing:
 *   dtc -I dts -O dtb -o kaslr_overlay.dtbo kaslr_overlay.dts
 */

/ {
	fragment@0 {
		target-path = "/chosen";
		__overlay__ {
			kaslr-seed = <0x00000000 0x00000000>;
		};
	};
};
